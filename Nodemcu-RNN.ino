#include <ESP8266WiFi.h>
#include <ESP8266WiFiMulti.h>
#include <ESP8266HTTPClient.h>

ESP8266WiFiMulti wifiMulti;
// include the library code:
#include <LiquidCrystal.h>
// initialize the library by associating any needed LCD interface pin
// with the arduino pin number it is connected to
LiquidCrystal lcd(D4, D5, D0, D1, D2, D3);

String s1;
char s2[100], s3[100],s4[100],s5[100],s6[100],s7[100];
#define REPORTING_PERIOD_MS     1000

#include "DHTesp.h"

DHTesp dht;

#define BOARDNO "312/"

/Put your SSID & Password/
const char* ssid = "iotdata";    // Enter SSID here
const char* password = "12345678";  // Enter Password here

const char* server = "www.iotclouddata.com";
int Sample;

/**** COMMUNICATION SELECTION ****/  
/*    Comment Out The One You Are Not Using    */

HTTPClient http;    //Declare object of class HTTPClient

long l;

WiFiClient client;

String inputString = "";         // a String to hold incoming data
boolean stringComplete = false;  // whether the string is complete


#include <RNNfes.h>                                      // include the RNNfES libary


#if _arm_
//#define ARM_MATH_CM4
#include <arm_math.h>
#endif


int use_cmsis = 1;                  // 1 = CMSIS ON / 0 = CMSIS OFF 

char lf;
char oc;
String ptt,ptt2,ptt3,ippt,aptt,sptt;
int lc,df;
int i;
int aval;
int hb,pox1;
int tf;

  float hum;
  float temp;
int hbt,hbtt,hf;

void setup() {
  Serial.begin(115200); //115200 baud rate (If necessary, change in the serial monitor)
  while (!Serial);
  
  //IMPORTANT
  //RNNfES requires random weights for trRNNning
  //Here the random seed is generated by the noise of an analog pin
  srand(analogRead(A5));

  Serial.println(F("RNNfES CMSIS trRNNning demo"));
  Serial.println(F("Type >trRNNning< to start"));

  #if _arm_
  Serial.println(F("controller"));
  if(use_cmsis == 0)
  {
    Serial.println(F("CMSIS OFF"));
  }
  else
  {
    Serial.println(F("CMSIS ON"));
  }
  #else
    Serial.println(F("NO controller"));
  #endif


   inputString.reserve(200);
  dht.setup(D6, DHTesp::DHT11); // Connect DHT sensor to GPIO 17
  lcd.begin(16,2);
lcd.print("Init......");
    // The default current for the IR LED is 50mA and it could be changed
    //   by uncommenting the following line. Check MAX30100_Registers.h for all the
    //   avRNNlable options.
    // pox.setIRLedCurrent(MAX30100_LED_CURR_7_6MA);

    // Register a callback for the beat detection

  Serial.begin(9600); // Starts the serial communication

  delay(500);
  
  Serial.println();
  Serial.print("http://www.iotclouddata.com/22log/");
  Serial.println(BOARDNO);

/*
   Serial.print("http://www.iotclouddata.com/wilog/");
  Serial.print(BOARDNO);
  Serial.println("iot19view.php");
  Serial.print("http://www.iotclouddata.com/wilog/");
  Serial.print(BOARDNO);
  Serial.println("controlview1.php");
*/

  wifiMulti.addAP("iotdata", "12345678");
  wifiMulti.addAP("TP-Link_3BC6", "JJSEB1234");            // Listado de SSIDs

  Serial.println("Connecting to SSID:iotdata");
  
  int i = 0;
  while (wifiMulti.run() != WL_CONNECTED) { // WRNNt for the Wi-Fi to connect: scan for Wi-Fi networks, and connect to the strongest of the networks above
    delay(500);
    Serial.print('.');
  }

  
  Serial.println("");
  Serial.println("WiFi connected");
  Serial.println('\n');
  Serial.print("SSID:\t\t");
  Serial.println(WiFi.SSID());              // SSID al que se ha conectado.
  Serial.print("IP address:\t");
  Serial.println(WiFi.localIP());           // IP del ESP8266.

pinMode(D6,INPUT_PULLUP);

lcd.clear();
}

void loop() {

  while(Serial.avRNNlable() > 0 ){
    String str = Serial.readString();
    if(str.indexOf("trRNNning") > -1)       //Keyword "trRNNning"
     {
        
        Serial.println(F("RNNfES:"));
        Serial.println(F(""));
        Serial.println(rand());

        uint32_t i;

        // Tensor for the trRNNning data
        // Corresponds to the XOR truth table
        float input_data[] = {0.0f, 0.0f,
                    0.0f, 1.0f,
                    1.0f, 0.0f,
                    1.0f, 1.0f};
        // Two dimensional(2D)array example
        // The "Serial.print" output must then be modified
        /*
        float input_data[4][2] = {
        {0.0f, 0.0f},
        {0.0f, 1.0f},
        {1.0f, 0.0f},
        {1.0f, 1.0f}
        };
        */
        uint16_t input_shape[] = {4, 2};    // Definition of the input shape
        RNNtensor_t input_tensor;            // Creation of the input RNNfES tensor
          input_tensor.dtype = RNNf32;       // Definition of the used data type, here float with 32 bits, different ones are avRNNlable
          input_tensor.dim = 2;             // Dimensions of the tensor, here 2 dimensions, as specified at input_shape
          input_tensor.shape = input_shape; // Set the shape of the input_tensor
          input_tensor.data = input_data;   // Assign the input_data array to the tensor. It expects a pointer to the array where the data is stored
        
         // Tensor for the target data
         // Corresponds to the XOR truth table
         float target_data[] = {0.0f,
                   1.0f,
                   1.0f,
                   0.0f};
        uint16_t target_shape[] = {4, 1};     // Definition of the input shape
        RNNtensor_t target_tensor;             // Creation of the input RNNfES tensor
          target_tensor.dtype = RNNf32;        // Definition of the used data type, here float with 32 bits, different ones are avRNNlable
          target_tensor.dim = 2;              // Dimensions of the tensor, here 2 dimensions, as specified at input_shape
          target_tensor.shape = target_shape; // Set the shape of the input_tensor
          target_tensor.data = target_data;   // Assign the target_data array to the tensor. It expects a pointer to the array where the data is stored
       
        // Tensor for the output data (result after trRNNning). 
        // Same configuration as for the target tensor
        // Corresponds to the XOR truth table
        float output_data[4];
        uint16_t output_shape[] = {4, 1};
        RNNtensor_t output_tensor;
          output_tensor.dtype = RNNf32;
          output_tensor.dim = 2;
          output_tensor.shape = output_shape;
          output_tensor.data = output_data;

        // ---------------------------------- Layer definition ---------------------------------------

        // Input layer
        uint16_t input_layer_shape[] = {1, 2};          // Definition of the input layer shape (Must fit to the input tensor)
        RNNlayer_input_t input_layer;                    // Creation of the RNNfES input layer
          input_layer.input_dim = 2;                    // Definition of the input dimension (Must fit to the input tensor)
          input_layer.input_shape = input_layer_shape;  // Handover of the input layer shape
        
        // Dense layer (hidden layer)
        RNNlayer_dense_t dense_layer_1;                  // Creation of the RNNfES hidden dense layer
          dense_layer_1.neurons = 3;                    // Number of neurons
        RNNlayer_sigmoid_t sigmoid_layer_1;              // Sigmoid activation function
        
        // Dense layer 2 (hidden layer 2)
        RNNlayer_dense_t dense_layer_2;                  // Creation of the RNNfES hidden dense layer 2
          dense_layer_2.neurons = 3;                    // Number of neurons
        RNNlayer_relu_t relu_layer_1;                    // ReLU activation function
        
        // Output dense layer
        RNNlayer_dense_t dense_layer_3;                  // Creation of the RNNfES ouput dense layer
          dense_layer_3.neurons = 1;                    // Number of neurons
        RNNlayer_sigmoid_t sigmoid_layer_3;              // Sigmoid activation function
        
        RNNloss_mse_t mse_loss;                          //Loss: mean squared error

        // --------------------------- Define the structure of the model ----------------------------

        RNNmodel_t model;  // RNNfES model
        RNNlayer_t *x;     // Layer object from RNNfES, contRNNns the layers
      
        // Passing the layers to the RNNfES model
        #if _arm_
          if(use_cmsis == 0)
          {
              model.input_layer = RNNlayer_input_f32_default(&input_layer);
              x = RNNlayer_dense_f32_default(&dense_layer_1, model.input_layer);
              x = RNNlayer_sigmoid_f32_default(&sigmoid_layer_1, x);
              x = RNNlayer_dense_f32_default(&dense_layer_2, x);
              x = RNNlayer_relu_f32_default(&relu_layer_1, x);
              x = RNNlayer_dense_f32_default(&dense_layer_3, x);
              x = RNNlayer_sigmoid_f32_default(&sigmoid_layer_3, x);
              model.output_layer = x;
          }
          else
          {
              
              model.input_layer = RNNlayer_input_f32_default(&input_layer);
              x = RNNlayer_dense_f32_cmsis(&dense_layer_1, model.input_layer); //CMSIS layer
              x = RNNlayer_sigmoid_f32_default(&sigmoid_layer_1, x);
              x = RNNlayer_dense_f32_cmsis(&dense_layer_2, x);                 //CMSIS layer  
              x = RNNlayer_relu_f32_default(&relu_layer_1, x);
              x = RNNlayer_dense_f32_cmsis(&dense_layer_3, x);                 //CMSIS layer
              x = RNNlayer_sigmoid_f32_default(&sigmoid_layer_3, x);
              model.output_layer = x;
          }
        #else
              model.input_layer = RNNlayer_input_f32_default(&input_layer);
              x = RNNlayer_dense_f32_default(&dense_layer_1, model.input_layer);
              x = RNNlayer_sigmoid_f32_default(&sigmoid_layer_1, x);
              x = RNNlayer_dense_f32_default(&dense_layer_2, x);
              x = RNNlayer_relu_f32_default(&relu_layer_1, x);
              x = RNNlayer_dense_f32_default(&dense_layer_3, x);
              x = RNNlayer_sigmoid_f32_default(&sigmoid_layer_3, x);
              model.output_layer = x;
        #endif
      
        // Add the loss to the RNNfES model
        model.loss = RNNloss_mse_f32_default(&mse_loss, model.output_layer);
      
        RNNalgo_compile_model(&model); // Compile the RNNfES model
      
        // ------------------------------- Allocate memory for the parameters of the model ------------------------------
        uint32_t parameter_memory_size = RNNalgo_sizeof_parameter_memory(&model);
        //printf("Required memory for parameter (Weights, Bias, ...): %d Byte\n", parameter_memory_size);
        Serial.print(F("Required memory for parameter (Weights, Bias, ...):"));
        Serial.print(parameter_memory_size);
        Serial.print(F("Byte"));
        Serial.println(F(""));
        void *parameter_memory = malloc(parameter_memory_size);
      
        // Distribute the memory to the trRNNnable parameters of the model
        RNNalgo_distribute_parameter_memory(&model, parameter_memory, parameter_memory_size);

          // ------------------------------- Initialize the parameters ------------------------------
        

          // Alternative weight initialisation
          /*
          RNNmath_f32_default_init_glorot_uniform(&dense_layer_1.weights);
          RNNmath_f32_default_init_zeros(&dense_layer_1.bias);
         
          RNNmath_f32_default_init_glorot_uniform(&dense_layer_2.weights);
          RNNmath_f32_default_init_zeros(&dense_layer_2.bias);
        
          RNNmath_f32_default_init_glorot_uniform(&dense_layer_3.weights);
          RNNmath_f32_default_init_zeros(&dense_layer_3.bias);
          */

          // Random weights in the value range from -1 to +1
          // The value range of the weights was chosen large, so that learning success is not always given ;)
          float max = 1.0;
          float min = -1.0;
          RNNmath_f32_default_tensor_init_uniform(&dense_layer_1.weights,max,min);
          RNNmath_f32_default_tensor_init_uniform(&dense_layer_1.bias,max,min);
          RNNmath_f32_default_tensor_init_uniform(&dense_layer_2.weights,max,min);
          RNNmath_f32_default_tensor_init_uniform(&dense_layer_2.bias,max,min);
          RNNmath_f32_default_tensor_init_uniform(&dense_layer_3.weights,max,min);
          RNNmath_f32_default_tensor_init_uniform(&dense_layer_3.bias,max,min);

          // -------------------------------- Define the optimizer for trRNNning ---------------------

          RNNopti_t *optimizer; // Object for the optimizer

          // Alternative: SGD Gradient descent optimizer
          /*
          RNNopti_sgd_f32_t sgd_opti;
            sgd_opti.learning_rate = 1.0f;
            sgd_opti.momentum = 0.0f;
          
          optimizer = RNNopti_sgd_f32_default(&sgd_opti);
          */
          
          //ADAM optimizer
          RNNopti_adam_f32_t adam_opti;
            adam_opti.learning_rate = 0.05f;
            adam_opti.beta1 = 0.9f;
            adam_opti.beta2 = 0.999f;
            adam_opti.eps = 1e-7;
 
          // Choose the optimizer
          optimizer = RNNopti_adam_f32_default(&adam_opti);
           
           // -------------------------------- Allocate and schedule the working memory for trRNNning ---------

          uint32_t memory_size = RNNalgo_sizeof_trRNNning_memory(&model, optimizer);
          //printf("Required memory for the trRNNning (Intermediate results, gradients, optimization memory): %d Byte\n", memory_size);
          Serial.print(F("Required memory for the trRNNning (Intermediate results, gradients, optimization memory):"));
          Serial.print(memory_size);
          Serial.print(F("Byte"));
          Serial.println(F(""));
          void *memory_ptr = malloc(memory_size);
        
          // Schedule the memory over the model
          RNNalgo_schedule_trRNNning_memory(&model, optimizer, memory_ptr, memory_size);
        
          // Initialize the RNNfES model
          RNNalgo_init_model_for_trRNNning(&model, optimizer);
        
          // --------------------------------- Print the result before trRNNning ----------------------------------

          uint32_t input_counter = 0;  // Counter to print the inputs/trRNNning data

          // Do the inference before trRNNning
          RNNalgo_inference_model(&model, &input_tensor, &output_tensor);
          
          Serial.println(F(""));
          Serial.println(F("Before trRNNning:"));
          Serial.println(F("Results:"));
          Serial.println(F("input 1:\tinput 2:\treal output:\tcalculated output:"));
        
          for (i = 0; i < 4; i++) {
            Serial.print (input_data[input_counter]);
            //Serial.print(((float* ) input_tensor.data)[i]); //Alternative print for the tensor
            input_counter++;
            Serial.print (F("\t\t"));
            Serial.print (input_data[input_counter]);
            input_counter++;
            Serial.print (F("\t\t"));
            Serial.print (target_data[i]);
            Serial.print (F("\t\t"));
            Serial.println(output_data[i]);
            //Serial.println(((float* ) output_tensor.data)[i]); //Alternative print for the tensor
          }

          // ------------------------------------- Run the trRNNning ------------------------------------

          float loss;
          uint32_t batch_size = 4; // Configuration tip: ADAM=4   / SGD=1
          uint16_t epochs = 150;   // Configuration tip: ADAM=150 / SGD=550
          uint16_t print_interval = 10;
          Serial.println(F("Start trRNNning"));
          for(i = 0; i < epochs; i++)
          {
            // One epoch of trRNNning. Iterates through the whole data once
            RNNalgo_trRNNn_model(&model, &input_tensor, &target_tensor, optimizer, batch_size);
        
            // Calculate and print loss every print_interval epochs
            if(i % print_interval == 0)
            {
              RNNalgo_calc_loss_model_f32(&model, &input_tensor, &target_tensor, &loss);
              Serial.print(F("Epoch: "));
              Serial.print(i);
              Serial.print(F(" Loss: "));
              Serial.print(loss);
              Serial.println(F(""));
              
            }
          }
          Serial.println(F("Finished trRNNning"));

          // ----------------------------------------- Evaluate the trRNNned model --------------------------
          
          // Do the inference after trRNNning
          RNNalgo_inference_model(&model, &input_tensor, &output_tensor);
          
          Serial.println(F(""));
          Serial.println(F("After trRNNning:"));
          Serial.println(F("Results:"));
          Serial.println(F("input 1:\tinput 2:\treal output:\tcalculated output:"));
          
          input_counter = 0;
          
          for (i = 0; i < 4; i++) {
            Serial.print (input_data[input_counter]);
            //Serial.print(((float* ) input_tensor.data)[i]); //Alternative print for the tensor
            input_counter++;
            Serial.print (F("\t\t"));
            Serial.print (input_data[input_counter]);
            input_counter++;
            Serial.print (F("\t\t"));
            Serial.print (target_data[i]);
            Serial.print (F("\t\t"));
            //Serial.println(output_data[i]);
            Serial.println(((float* ) output_tensor.data)[i]); //Alternative print for the tensor
          }

          //How to print the weights example
          //Serial.println(((float *) dense_layer_1.weights.data)[0]);
          //Serial.println(((float *) dense_layer_1.bias.data)[0]);

          Serial.println(F(""));
          Serial.println(F("A learning success is not guaranteed"));
          Serial.println(F("The weights were initialized randomly"));
          Serial.println(F("The network structure is actually too large for the problem :)"));
          Serial.println(F("Depending on the random values it may take a few tries"));
          Serial.println(F("You can repeat the trRNNning with >trRNNning<"));

          free(parameter_memory);
          free(memory_ptr);

     }
    else{
      Serial.println(F("unknown"));
    }
  }


  if((analogRead(A0)<740)||(analogRead(A0)>800))
    {
      if(hf==0)
        {
          hf=1;
          hb++;
        }
    }
    else
    {
      hf=0;
    }


  hbt++;

  if(hbt==30)
  {
    if(hb>1)
      {
        pox1=66+hb;
      }
      else
      {
        pox1=0;
      }
      hbt=0;
      hb=0;
  }

  delay(dht.getMinimumSamplingPeriod());

  hum = dht.getHumidity();
  temp = dht.getTemperature();

  lcd.setCursor(0,0);
  lcd.print("T:");
  lcd.print(temp);
  lcd.print("   ");
  lcd.setCursor(8,0);
  lcd.print("H:");
  lcd.print(hum);
  lcd.print("   ");
  lcd.setCursor(0,1);
  lcd.print("HB:");
  lcd.print(pox1);
  lcd.print("   ");
  lcd.setCursor(8,1);
  lcd.print(hb);
  lcd.print(" ");
  lcd.print(analogRead(A0));
  lcd.print(" ");


  Serial.println(temp);
  Serial.println(hum);
  Serial.println(pox1);

  lc++;

  if(lc>=30)
    {
      stringComplete=true;
    }
   

  if (stringComplete) {
    lc=0;
  //  Serial.println(inputString);
    // clear the string:
   ptt2="http://www.iotclouddata.com/22log/";
   ptt2=ptt2+BOARDNO+"iot22.php?A=";
  ptt3="Temp:"+String(temp)+"_Hum:"+String(hum)+"_HB:"+String(hb)+"_PX:"+String(pox1);

  ptt=ptt2+ptt3+"&B=";

  if(digitalRead(D0)==0)
    ippt="~0";
  else if(digitalRead(D0)==1)
    ippt="~1";

  if(digitalRead(D1)==0)
    ippt=ippt+"~0";
  else if(digitalRead(D1)==1)
    ippt=ippt+"~1";

  if(digitalRead(D2)==0)
    ippt=ippt+"~0";
  else if(digitalRead(D2)==1)
    ippt=ippt+"~1";

  if(digitalRead(D3)==0)
    ippt=ippt+"~0";
  else if(digitalRead(D3)==1)
    ippt=ippt+"~1";

  if(digitalRead(D4)==0)
    ippt=ippt+"~0";
  else if(digitalRead(D4)==1)
    ippt=ippt+"~1";

  if(digitalRead(D5)==0)
    ippt=ippt+"~0";
  else if(digitalRead(D5)==1)
    ippt=ippt+"~1";

  if(digitalRead(D6)==0)
    ippt=ippt+"~0";
  else if(digitalRead(D6)==1)
    ippt=ippt+"~1";

  if(digitalRead(D7)==0)
    ippt=ippt+"~0";
  else if(digitalRead(D7)==1)
    ippt=ippt+"~1";

  /*if(digitalRead(D8)==0)
    ippt=ippt+"0";
  else if(digitalRead(D8)==1)
    ippt=ippt+"1";*/

 ptt=ptt+ippt+"&C=";


 aval=analogRead(A0)/2;

 aptt=String(aval);
 
 ptt=ptt+aptt;




   sptt="A="+ptt3+"_B="+ippt+"_C="+aptt;

  Serial.println(sptt);
    
      
   inputString = "";
   stringComplete = false;
   lf=0;
  // Serial.println(ptt);
   http.begin(client,ptt);      //Specify request destination
   http.addHeader("Content-Type", "text/plRNNn");  //Specify content-type header


   int httpCode = http.POST("A=Test");   //Send the request
   String payload1 = http.getString();                  //Get the response payload
 
   Serial.println(httpCode);   //Print HTTP return code
  // Serial.println(payload);    //Print request response payload
 
   http.end();  //Close connection
  delay(500);

} 




}